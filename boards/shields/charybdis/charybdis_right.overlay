/*
 * Copyright (c) 2020 ZMK Contributors
 *
 * SPDX-License-Identifier: MIT
 */
 
#include "charybdis.dtsi"
#include "charybdis_pmw3610.dtsi"
#include "charybdis_trackball_processors.dtsi"

&default_transform {
    col-offset = <6>;
}; 

&kscan0 {
    col-gpios
        = <&gpio0 2 GPIO_ACTIVE_HIGH>
        , <&gpio0 29 GPIO_ACTIVE_HIGH>
        , <&gpio0 9 GPIO_ACTIVE_HIGH>
        , <&gpio1 0  GPIO_ACTIVE_HIGH>
        , <&gpio0 11 GPIO_ACTIVE_HIGH>
        , <&gpio1 4  GPIO_ACTIVE_HIGH>
        ;
};

/ {
    trackball_listener {
        compatible = "zmk,input-listener";
        status = "okay";
        device = <&trackball>;

        CHARYBDIS_TRACKBALL_PROCESSORS

    };
};

&led_strip {
  chain-length = <27>;
};
