## boards/shields/charybdis/Kconfig.defconfig
```kconfig
# Copyright (c) 2022 ZMK Contributors
# SPDX-License-Identifier: MIT

if SHIELD_CHARYBDIS_RIGHT

config ZMK_KEYBOARD_NAME
	default "Charybdis"

config ZMK_SPLIT_ROLE_CENTRAL
    default y

endif # SHIELD_CHARYBDIS_RIGHT

if SHIELD_CHARYBDIS_LEFT || SHIELD_CHARYBDIS_RIGHT

config ZMK_SPLIT
    default y

endif # SHIELD_CHARYBDIS_LEFT || SHIELD_CHARYBDIS_RIGHT
```
